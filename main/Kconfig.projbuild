## main/Kconfig.projbuild
```kconfig
menu "TireX Bridge Options"

config TIREX_DECODER_CONSOLE_LOGGING
    bool "Enable TireX decoder console logging"
    default y
    help
        Prints decoded TireX temperatures to the serial console when CAN
        frames are received. Disable this to reduce log noise during normal
        BLE bridge operation.

config TIREX_FORWARD_ALL_PIDS_OVER_BLE
    bool "Forward all CAN PIDs over BLE"
    default n
    help
        Forwards every extended CAN frame over BLE, regardless of RaceChrono
        filter commands. When disabled, the bridge still forwards TireX CAN
        frames, but other PIDs remain controlled by the RaceChrono filter
        characteristic.

config TIREX_DISABLE_ALL_CONSOLE_LOGGING
    bool "Disable all console logging"
    default n
    help
        Suppresses all ESP-IDF console logging from this firmware after startup.
        Enable this for a completely quiet build when you do not want any
        serial log output from the bridge.

config TIREX_SUPPRESS_BLE_IDLE_SEND_WARNINGS
    bool "Suppress BLE idle send warnings"
    default y
    help
        Suppresses the warning that would otherwise appear when the bridge
        has CAN or telemetry data to send but no RaceChrono BLE client is
        currently connected. Keep this enabled for normal use so the monitor
        stays quiet unless there is a real BLE error.

endmenu

menu "EXLAP Gateway Options"

config EXLAP_TESTING_AP_UI
    bool "Enable troubleshooting SoftAP and web UI"
    default y
    help
        Enables the EXLAP-Gateway SoftAP, the local web diagnostics UI,
        and the manual WiFi join/stop controls used for troubleshooting.
        Disable this for a quieter STA-only build that connects directly
        to the vehicle WiFi using saved credentials.

config EXLAP_ENABLED
    bool "Enable EXLAP telemetry gateway"
    default y
    help
        Enables the EXLAP TCP client for connecting to VAG vehicle
        telemetry services over WiFi. When enabled, the firmware will
        initialize WiFi and attempt to connect to the configured
        vehicle EXLAP service.

config EXLAP_PARSER_DEBUG_LOGGING
    bool "Enable EXLAP parser debug logging"
    default n
    depends on EXLAP_ENABLED
    help
        Enables verbose debug logging inside the EXLAP parser for
        troubleshooting tag extraction and buffer state. Disable in
        production to reduce log overhead.

config EXLAP_PARSER_CONSOLE_LOGGING
    bool "Enable EXLAP parser console logging"
    default y
    depends on EXLAP_ENABLED
    help
        Prints parsed EXLAP telemetry data to the serial console.
        Disable this to reduce log noise during normal operation.

config EXLAP_AUTO_CONNECT
    bool "Auto-connect to EXLAP on startup"
    default y
    depends on EXLAP_ENABLED
    help
        Automatically attempts to connect to the vehicle EXLAP service
        on startup using saved NVS credentials.

endmenu
```

## sdkconfig.defaults
```kconfig
# ESP32-S3 Target
CONFIG_IDF_TARGET="esp32s3"

# Enable Bluetooth
CONFIG_BT_ENABLED=y
CONFIG_BT_NIMBLE_ENABLED=y
CONFIG_BT_NIMBLE_ROLE_PERIPHERAL=y

# Enable WiFi
CONFIG_ESP_WIFI_ENABLED=y
CONFIG_ESP_WIFI_STATIC_RX_BUFFER_NUM=8
CONFIG_ESP_WIFI_DYNAMIC_RX_BUFFER_NUM=32
CONFIG_ESP_WIFI_STATIC_TX_BUFFER=y
CONFIG_ESP_WIFI_TX_BUFFER_TYPE=0
CONFIG_ESP_WIFI_CSI_ENABLED=n
CONFIG_ESP_WIFI_AMPDU_TX_ENABLED=y
CONFIG_ESP_WIFI_AMPDU_RX_ENABLED=y

# Enable LWIP
CONFIG_LWIP_IPV6=n

# FreeRTOS
CONFIG_FREERTOS_HZ=1000

# Serial flasher config
CONFIG_ESPTOOLPY_FLASHSIZE_4MB=y
CONFIG_ESPTOOLPY_FLASHFREQ_80M=y
CONFIG_ESPTOOLPY_FLASHMODE_QIO=y

# Partition Table
CONFIG_PARTITION_TABLE_SINGLE_APP_LARGE=y
CONFIG_PARTITION_TABLE_FILENAME="partitions_singleapp_large.csv"

# Logging
CONFIG_LOG_DEFAULT_LEVEL_INFO=y
CONFIG_LOG_MAXIMUM_LEVEL_INFO=y
CONFIG_TIREX_SUPPRESS_BLE_IDLE_SEND_WARNINGS=y

# EXLAP Gateway
CONFIG_EXLAP_TESTING_AP_UI=y
CONFIG_EXLAP_ENABLED=y
CONFIG_EXLAP_PARSER_CONSOLE_LOGGING=y
CONFIG_EXLAP_AUTO_CONNECT=y
```
